#include "oled.h"






//NOTE: the RST pin (RB12) has been converted to MISO to function better as a default SPI device.
//  Change it to a GPIO Output to function properly!
// more things have been changed I think.  Change em back.









//This driver is optimized for SPI displays, and uses on-board frame buffers a lot.  Use a SPI display.

unsigned char oled_gbuf[OLED_HEIGHT * OLED_WIDTH / 8];
//1K frame buffer for all screen ops

int charin = 0;
//index for all text operations

//font copied from adafruit for ease of use, might make own in the future
const static uint8_t font[] = { //should get a list of all the stuff in here at some point
    0x00, 0x00, 0x00, 0x00, 0x00, 0x3E, 0x5B, 0x4F, 0x5B, 0x3E, 0x3E, 0x6B, 0x4F, 0x6B, 0x3E, 	
	0x1C, 0x3E, 0x7C, 0x3E, 0x1C, 0x18, 0x3C, 0x7E, 0x3C, 0x18, 0x1C, 0x57, 0x7D, 0x57, 0x1C, 
	0x1C, 0x5E, 0x7F, 0x5E, 0x1C, 0x00, 0x18, 0x3C, 0x18, 0x00, 0xFF, 0xE7, 0xC3, 0xE7, 0xFF, 
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	0x00, 0x19, 0x1D, 0x17, 0x12, 0x00, 0x3C, 0x3C, 0x3C, 0x3C, 0x00, 0x00, 0x00, 0x00, 0x00, 
};

//define to select bus type
#ifdef OLED_I2C_BUS
void oled_command(uint8_t x) {
    i2c_start();
    i2c_send(OLED_WRITE_ADDR); //write address onto bus
    i2c_send(0x00); //command, not data
    i2c_send(x); //write actual command
    i2c_stop();
}

void oled_data(uint8_t x) {
    i2c_start();
    i2c_send(OLED_WRITE_ADDR); //write address
    i2c_send(0x40); //data, not command
    i2c_send(x); //actual data
    i2c_stop();
}
void oled_flush(void) {
    oled_command(0x21); //select column address
    oled_command(0x00); //set start address to 0
    oled_command(OLED_WIDTH-1); //set end to end of display
    
    oled_command(0x22); //select page address
    oled_command(0x00); //set start to 0
    oled_command(0x07); //set end to page 7
    
    //write out entire buffer to screen, in one transmission
    //applies only to screen using settings listed above
    for (int i = 0; i < (OLED_WIDTH * OLED_HEIGHT / 8); i++) {
        i2c_start();
        i2c_send(OLED_WRITE_ADDR);
        i2c_send(0x40); //data transmission, not command transmission
        for (int j = 0; j < 16; j++) {
            i2c_send(oled_gbuf[i++]);
        }
        i--; //??
        i2c_stop();
    }
}

void oled_reset(void) {
    ; //no reset button for i2c module
}
#elif defined OLED_SPI_BUS

//tie reset pin to MCLR
inline void oled_command(uint8_t x) {
    DCPIN_SetLow();
    SPI2_Exchange8bit(x);
    DCPIN_SetHigh();
}

inline void oled_data(uint8_t x) {
    //do not touch LEDPIN, assumed to be high
    SPI2_Exchange8bit(x);
    
}
void oled_flush(void) {
    oled_command(0x21); //select column address
    oled_command(0x00); //set start address to 0
    oled_command(OLED_WIDTH-1); //set end to end of display
    
    oled_command(0x22); //select page address
    oled_command(0x00); //set start to 0
    oled_command(0x07); //set end to page 7
    
    //write out entire buffer to screen, in one transmission
    //applies only to screen using settings listed above
    for (int i = 0; i < (OLED_WIDTH * OLED_HEIGHT / 8); i++) {
        oled_data(oled_gbuf[i]);
    }
}

void oled_reset(void) {
    RESETPIN_SetLow();
    delay_poll(MS_10);
    RESETPIN_SetHigh();
    oled_displayoff();
}

#else
    #error "No interface specified!"

#endif

//initialize oled screen, relies on internal Vcc
//mostly copied from adafruit SSD1306 driver github
void oled_init(void) {
    oled_reset();
    oled_command(0xD5); //set display clock div
    oled_command(0x80); //clock ratio of 0x80
    oled_command(0xA8); //set multiplex
    oled_command(OLED_HEIGHT-1); //relies on height
    oled_command(0xD3); //set display offset
    oled_command(0x00); //no offset
    oled_command(0x40); //set start line to line 0
    oled_command(0x8D); //set charge pumps
    oled_command(0x14); //no external Vcc, generate voltage internally
    oled_command(0x20); //set memory mode
    oled_command(0x00); //horizontal addressing mode
    oled_command(0xA1); //??
    oled_command(0xC8); //scan descending
    oled_command(0xDA); //set com pins?
    oled_command(0x12); //??
    oled_command(0x81); //set contrast
    oled_command(0xCF); //related to Vcc for some reason
    oled_command(0xD9); //set precharge detect?
    oled_command(0xF1); //internal Vcc
    oled_command(0xDB); //v com detect
    oled_command(0x40); //?
    oled_command(0xA4); //resume display
    oled_command(0xA6); //normal display
    oled_command(0x2E); //deactivate scroll
    oled_clear();
    oled_displayon();
}
//changes have to be written out to take effect

//these operations abstract away from harder internal storage method
inline void oled_setpixel(uint16_t x, uint16_t y) {
    oled_gbuf[(x) + (((y) / 8) * OLED_WIDTH)] |= (1 << ((y) & 7));
}

inline void oled_clearpixel(uint16_t x, uint16_t y) {
    oled_gbuf[(x) + (((y) / 8) * OLED_WIDTH)] &= ~(1 << ((y) & 7));
}

inline void oled_togglepixel(uint16_t x, uint16_t y) {
    oled_gbuf[(x) + (((y) / 8) * OLED_WIDTH)] ^= (1 << ((y) & 7));
}

void oled_clear(void) {
    memset(oled_gbuf, 0x00, sizeof(unsigned char) * (OLED_WIDTH * OLED_HEIGHT / 8)); //clear internal buffer
    oled_flush();
    charin = 0;
}

//bresnham's algorithm, used to draw accurate lines cheaply
//pulled from google
//uint16_t x0, uint16_t y0, uint16_t x1, uint16_t y1
void oled_line(oled_pt_t start, oled_pt_t end) {
    int dx = abs(end.x-start.x), sx = start.x < end.x ? 1 : -1;
    int dy = abs(end.y-start.y), sy = start.y < end.y ? 1 : -1; //dy = delta of y0 to y1, sy = sign
    int err = (dx>dy ? dx : -dy)/2, e2; //adjust for inverse lines
 
    for(;;) {
        oled_setpixel(start.x, start.y);
        if (start.x == end.x && start.y == end.y) break; //are we finished?
        e2 = err; //accumulate error over time... pretty cool
        if (e2 >-dx) { err -= dy; start.x += sx; } //which way are we going?
        if (e2 < dy) { err += dx; start.y += sy; }
    }
}

//write a character to global buffer
void oled_char(char c) {
    for (int i = (c * 5); i < ((c+1) * 5); i++) {
        oled_gbuf[charin++] = font[i]; //write the 5*7 character to screen
    }
}

//NOTE: some of these functions use a global buffer that has to be flushed, and some use a
//the SSD1306's buffer directly.  Fix this please.

//write a string, using the cursor as a starting point
void oled_str(char *s) { //does not include null term for screen
    for (int cursor = 0; cursor <= strlen(s)-1; cursor++) {
        if (cursor >= 25) { //is cursor at edge of screen?
            for (int j = 0; j < 3; j++) {
                oled_data(NULL); //just enough whitespace to roll over to next line
            }
        }
        oled_char(s[cursor]); //write next character
    }
}

void oled_setcursor(unsigned char c) {
    charin = c;
}

void oled_clearrow(int row) {
    charin = row << 7; //set index to start of row
    memset(oled_gbuf + charin, 0x00, OLED_WIDTH); //actually clear row
}
