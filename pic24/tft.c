#include "tft.h"

//as with most of my graphics code, this is ported (stolen) from Adafruit.
//they're cool.

const uint8_t font[] = { //should get a list of all the stuff in here at some point
    0x00, 0x00, 0x00, 0x00, 0x00, 0x3E, 0x5B, 0x4F, 0x5B, 0x3E, 0x3E, 0x6B, 0x4F, 0x6B, 0x3E, 	
	0x1C, 0x3E, 0x7C, 0x3E, 0x1C, 0x18, 0x3C, 0x7E, 0x3C, 0x18, 0x1C, 0x57, 0x7D, 0x57, 0x1C, 
	0x1C, 0x5E, 0x7F, 0x5E, 0x1C, 0x00, 0x18, 0x3C, 0x18, 0x00, 0xFF, 0xE7, 0xC3, 0xE7, 0xFF, 
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	0x00, 0x19, 0x1D, 0x17, 0x12, 0x00, 0x3C, 0x3C, 0x3C, 0x3C, 0x00, 0x00, 0x00, 0x00, 0x00, 
};

void writeData(uint8_t c) {
    DC_SetHigh();
    SS_SetLow();
    SPI2_Exchange8bit(c);
    SS_SetHigh();
}

//again, porting the Adafruit driver for the ILI9341 chip to the PIC24, and adding more comments
void writeCommand(uint8_t command) {
    DC_SetLow();
    SS_SetLow();
    SPI2_Exchange8bit(command);
    SS_SetHigh();
}

void writeData16(uint16_t data) {
    writeData(data >> 8);
    writeData(data & 0xFF);
}

//Note: TFT reading for more than one byte requires weird clock pin control.  Display works without this, come back to it

void tft_init(void) {
   writeCommand(0x01);
   //delay_poll(MS_1 * 5);
   delay_poll(MS_100 + (MS_10 * 2));
   
   writeCommand(0xEF);
   writeData(0x03);
   writeData(0x80);
   writeData(0x02);
   
   writeCommand(0xCF);  
   writeData(0x00); 
   writeData(0XC1); 
   writeData(0X30); 
   
   writeCommand(0xED);  
   writeData(0x64); 
   writeData(0x03); 
   writeData(0X12); 
   writeData(0X81); 
   
   writeCommand(0xE8);  
   writeData(0x85); 
   writeData(0x00); 
   writeData(0x78); 
   
   writeCommand(0xCB);  
   writeData(0x39); 
   writeData(0x2C); 
   writeData(0x00); 
   writeData(0x34); 
   writeData(0x02); 
   
   writeCommand(0xF7);  
   writeData(0x20); 
   
   writeCommand(0xEA);  
   writeData(0x00); 
   writeData(0x00); 
    
   writeCommand(0xC0);    //Power control 
   writeData(0x23);   //VRH[5:0] 
   
   writeCommand(0xC1);    //Power control 
   writeData(0x10);   //SAP[2:0];BT[3:0] 
   
   writeCommand(0xC5);    //VCM control 
   writeData(0x3e); //???????
   writeData(0x28); 
   
   writeCommand(0xC7);    //VCM control2 
   writeData(0x86);  //--
   
   writeCommand(0x36); //Memory access control - in what orientation the screen gets drawn 
   writeData(0x08);
  
   writeCommand(0x3A);    
   writeData(0x55); 
   
   writeCommand(0xB1);    
   writeData(0x00);  
   writeData(0x18); 
   
   writeCommand(0xB6);    // Display Function Control 
   writeData(0x08); 
   writeData(0x82);
   writeData(0x27);  
   
   writeCommand(0xF2);    // 3Gamma Function Disable 
   writeData(0x00); 
 
   writeCommand(0x26);    //Gamma curve selected 
   writeData(0x01); 
 
   writeCommand(0xE0);    //Set Gamma 
   writeData(0x0F); 
   writeData(0x31); 
   writeData(0x2B); 
   writeData(0x0C); 
   writeData(0x0E); 
   writeData(0x08); 
   writeData(0x4E); 
   writeData(0xF1); 
   writeData(0x37); 
   writeData(0x07); 
   writeData(0x10); 
   writeData(0x03); 
   writeData(0x0E); 
   writeData(0x09); 
   writeData(0x00); 
    
   writeCommand(0xE1);    //Set Gamma 
   writeData(0x00); 
   writeData(0x0E); 
   writeData(0x14); 
   writeData(0x03); 
   writeData(0x11); 
   writeData(0x07); 
   writeData(0x31); 
   writeData(0xC1); 
   writeData(0x48); 
   writeData(0x08); 
   writeData(0x0F); 
   writeData(0x0C); 
   writeData(0x31); 
   writeData(0x36); 
   writeData(0x0F);

   writeCommand(0x11);    //Exit Sleep 
   delay_poll(MS_100 + (MS_10 * 2));
   writeCommand(0x29);    //Display on
}

void tft_setAddrWindow(uint16_t x0, uint16_t y0, uint16_t x1, uint16_t y1) {
  writeCommand(0x2A); // Column addr set
  writeData(x0 >> 8);
  writeData(x0 & 0xFF);     // XSTART 
  writeData(x1 >> 8);
  writeData(x1 & 0xFF);     // XEND

  writeCommand(0x2B); // Row addr set
  writeData(y0>>8);
  writeData(y0);     // YSTART
  writeData(y1>>8);
  writeData(y1);     // YEND

  writeCommand(0x2C); // writeData to RAM
}

void tft_setPixel(uint16_t posX, uint16_t posY, uint16_t color) {
  writeCommand(0x2A); // Column addr set
  writeData(posX >> 8);
  writeData(posX & 0xFF);     // XSTART 
  writeData((posX+1) >> 8);
  writeData((posX+1) & 0xFF);     // XEND

  writeCommand(0x2B); // Row addr set
  writeData(posY >> 8);
  writeData(posY);     // YSTART
  writeData((posY+1) >> 8);
  writeData(posY+1);     // YEND

  writeCommand(0x2C); // writeData to RAM
  writeData16(color);
}

void tft_fillScreen(uint16_t color) {
  tft_setAddrWindow(0, 0, TFT_HEIGHT, TFT_WIDTH);
    
    for (uint32_t i = 0; i < 76800; i++) {
      writeData16(color);
    }
  writeCommand(0);
}

void tft_line(uint16_t startX, uint16_t startY, uint16_t endX, uint16_t endY, uint16_t color) {
    int dx = abs(endX-startX), sx = startX < endX ? 1 : -1;
    int dy = abs(endY-startY), sy = startY < endY ? 1 : -1; //dy = delta of y0 to y1, sy = sign
    int err = (dx>dy ? dx : -dy)/2, e2; //adjust for inverse lines
 
    for(;;) {
        tft_setPixel(startX, startY, color);
        if (startX == endX && startY == endY) break; //are we finished?
        e2 = err; //accumulate error over time... pretty cool
        if (e2 >-dx) { err -= dy; startX += sx; } //which way are we going?
        if (e2 < dy) { err += dx; startY += sy; }
    }
}

uint16_t color = TFT_COLOR_GREEN;

//xStart and yStart are flipped and I don't care.
void tft_char(uint16_t xStart, uint16_t yStart, char c) {
    tft_setAddrWindow(xStart, yStart, xStart+7, yStart+5);
    for (int byte = (c * 5); byte < ((c+1) * 5); byte++) {
        for (int bitPos = 0; bitPos < 8; bitPos++) {
            ((font[byte] >> bitPos) & 0x01) == 1 ? writeData16(color) : writeData16(0x0000);
        }
    }
}

void tft_str(uint16_t xStart, uint16_t yStart, char str[]) {
    for (int i = 0; i < strlen(str); i++) {
        tft_char(xStart, yStart + i * 5, str[i]);
    }    
}

void tft_blank(uint16_t xStart, uint16_t yStart, int num) {
    for (int i = 0; i < num; i++) {
        tft_char(xStart, yStart + i * 5, 0x00);
    }
}

void tft_bitmap(uint16_t xStart, uint16_t yStart, uint16_t xOffset, uint16_t yOffset, uint8_t bitmap[], uint16_t size) {
    tft_setAddrWindow(xStart, yStart, xStart + xOffset - 1, yStart + yOffset);
    for (int byte = 0; byte < size; byte++) {
        for (int bitPos = 0; bitPos < 8; bitPos++) {
            ((bitmap[byte] >> bitPos) & 0x01) == 1 ? writeData16(0xFFFF) : writeData16(0x0000);
        }
    }
}